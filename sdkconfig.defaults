## sdkconfig.defaults
```kconfig
CONFIG_MQTT_PROTOCOL_5=y
CONFIG_ESPTOOLPY_FLASHSIZE_4MB=y
CONFIG_ESPTOOLPY_HEADER_FLASHSIZE_UPDATE=y
CONFIG_PARTITION_TABLE_SINGLE_APP_LARGE=y
CONFIG_WIFI_SSID="qzm"
CONFIG_WIFI_PASSWORD="130168130168"
```
